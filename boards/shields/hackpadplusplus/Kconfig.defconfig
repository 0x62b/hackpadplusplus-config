## boards/shields/hackpadplusplus/Kconfig.defconfig
```kconfig
if SHIELD_HACKPADPLUSPLUS

config ZMK_KEYBOARD_NAME
    default "hackpadplusplus"

endif # SHIELD_HACKPADPLUSPLUS
```

## boards/shields/hackpadplusplus/Kconfig.shield
```kconfig
config SHIELD_HACKPADPLUSPLUS
    def_bool $(shields_list_contains,hackpadplusplus)
```

## config/west.yml
```yaml
manifest:
  remotes:
    - name: zmkfirmware
      url-base: https://github.com/zmkfirmware
    - name: hackpadplusplus-config
      url-base: https://github.com/0x62b
  projects:
    - name: zmk
      remote: zmkfirmware
      revision: main
      import: app/west.yml
    - name: hackpadplusplus-config
      remote: hackpadplusplus-config
      revision: main
  self:
    path: config
```
